## ESP32-P4_Function_EV_Board/main/Kconfig.projbuild
```kconfig
menu "P4 Control configuration"

    config APP_WIFI_SSID
        string "Wi-Fi SSID"
        default "YOUR_WIFI_SSID"

    config APP_WIFI_PASSWORD
        string "Wi-Fi password"
        default "YOUR_WIFI_PASSWORD"

    config APP_SC171_ENABLE
        bool "Send a/b/c commands to SC171 over UDP"
        default y

    config APP_SC171_HOST
        string "SC171 IPv4 address or host name"
        default "192.168.12.156"
        depends on APP_SC171_ENABLE

    config APP_SC171_PORT
        int "SC171 UDP port"
        range 1 65535
        default 9000
        depends on APP_SC171_ENABLE

    config APP_SC171_SEND_ATTEMPTS
        int "UDP attempts while waiting for SC171 acknowledgement"
        range 1 10
        default 3
        depends on APP_SC171_ENABLE

    config APP_SC171_ACK_TIMEOUT_MS
        int "SC171 acknowledgement timeout per attempt (ms)"
        range 100 5000
        default 700
        depends on APP_SC171_ENABLE

    config APP_SC171_BROADCAST_FALLBACK
        bool "Try UDP broadcast when configured SC171 address gives no acknowledgement"
        default y
        depends on APP_SC171_ENABLE

    config APP_SERVER_BASE_URL
        string "Image server base URL (without trailing slash)"
        default "http://8.140.192.151:5000"
        help
            PC test server URL. For local network development.
            Plain HTTP is fine for local testing.

    config APP_BEARER_TOKEN
        string "Image server bearer token (empty = no auth for local test)"
        default ""

    config APP_HTTP_TIMEOUT_MS
        int "HTTP request timeout (ms)"
        range 1000 120000
        default 10000

    config APP_SNTP_SERVER
        string "SNTP server used before HTTPS"
        default "pool.ntp.org"

    config APP_SNTP_TIMEOUT_MS
        int "SNTP synchronization timeout (ms)"
        range 1000 120000
        default 20000

    config APP_MAX_JPEG_BYTES
        int "Maximum compressed JPEG frame size"
        range 65536 4194304
        default 1048576

    config APP_DOWNLOAD_RETRIES
        int "Retries per cloud request"
        range 1 20
        default 3

    config APP_FRAME_DELAY_OVERRIDE_MS
        int "Cloud frame delay override in ms (0 uses manifest)"
        range 0 60000
        default 0

endmenu
```

## ESP32-P4_Function_EV_Board/sdkconfig.defaults
```kconfig
# Project and flash layout
CONFIG_PARTITION_TABLE_CUSTOM=y
CONFIG_PARTITION_TABLE_CUSTOM_FILENAME="partitions.csv"
CONFIG_PARTITION_TABLE_OFFSET=0x9000
CONFIG_ESPTOOLPY_FLASHSIZE_16MB=y
CONFIG_ESPTOOLPY_FLASHMODE_QIO=y
CONFIG_COMPILER_OPTIMIZATION_PERF=y
CONFIG_FREERTOS_HZ=1000
CONFIG_ESP_TASK_WDT_TIMEOUT_S=20
CONFIG_ESP_SYSTEM_USE_FRAME_POINTER=y

# HTTPS server certificate validation
CONFIG_MBEDTLS_CERTIFICATE_BUNDLE=y
CONFIG_MBEDTLS_CERTIFICATE_BUNDLE_DEFAULT_FULL=y

# LVGL 9
CONFIG_LV_CONF_SKIP=y
CONFIG_LV_BUILD_EXAMPLES=n
CONFIG_LV_USE_CLIB_MALLOC=y
CONFIG_LV_USE_CLIB_SPRINTF=y
CONFIG_LV_USE_CLIB_STRING=y
CONFIG_LV_DEF_REFR_PERIOD=10
CONFIG_LV_FONT_MONTSERRAT_20=y
CONFIG_LV_FONT_MONTSERRAT_24=y
CONFIG_LV_FONT_MONTSERRAT_48=y
CONFIG_LV_FONT_SOURCE_HAN_SANS_SC_16_CJK=y

# The cloud sequence defaults to roughly 20 FPS.
CONFIG_APP_FRAME_DELAY_OVERRIDE_MS=50
```
